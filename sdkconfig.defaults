## sdkconfig.defaults
```kconfig
# Set target to ESP32-C6
CONFIG_IDF_TARGET="esp32c6"
CONFIG_IDF_TARGET_ESP32C6=y

CONFIG_FREERTOS_HZ=1000

# Sleep config
CONFIG_ESP_SLEEP_GPIO_ENABLE_INTERNAL_RESISTORS=n
```
